## drivers/pmdomain/lontium/Kconfig
```kconfig
# SPDX-License-Identifier: GPL-2.0-only

menu "Lontium Semiconductor PM domains"

config LONTIUM_LT8618SXB_PM
	tristate "LT8618SXB power domain"
	depends on PM
	help
	  Enable support for LT8618SXB HDMI TX PM driver.
	  Say Y here if you have device with LT8618SXB.

endmenu
```

## drivers/video/rockchip/mpp/Kconfig
```kconfig
# SPDX-License-Identifier: (GPL-2.0+ OR MIT)

menuconfig ROCKCHIP_MPP_SERVICE
	tristate "mpp service framework"
	depends on ARCH_ROCKCHIP
	help
	  rockchip mpp service framework.

if ROCKCHIP_MPP_SERVICE

config ROCKCHIP_MPP_PROC_FS
	bool "mpp service procfs"
	depends on PROC_FS
	default y
	help
	  rockchip mpp service procfs.

config ROCKCHIP_MPP_RKVDEC2
	bool "RKV decoder v2 device driver"
	help
	  rockchip mpp rkv combo decoder v2.

endif
```
